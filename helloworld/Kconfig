## helloworld/Kconfig
```kconfig
config MYSERVICE
       bool "XXXXXXXXXXXXXXXXXXXXXXXXXXXXXXX"
       default y
       
```

## kernel/Kconfig.keystore
```kconfig
config KEYSTORE
	tristate "keystore app"
	default m
	help
		keystore application developed for OS course
```
